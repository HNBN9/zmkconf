/*
 * SPDX-License-Identifier: MIT
 */

/dts-v1/;
#include <nordic/nrf52840_qiaa.dtsi>
#include "obscura60-layouts.dtsi"

/ {
    model = "obscura60";
    compatible = "obscura60";

    chosen {
        zephyr,code-partition = &code_partition;
        zephyr,sram = &sram0;
        zephyr,flash = &flash0;
        zmk,kscan = &kscan0;
        zmk,physical-layout = &obscura60_layout;
    };

      default_transform: keymap_transform_0 {
        compatible = "zmk,matrix-transform";
        columns = <15>;
        rows = <5>;
        map = <
0 1 2 3 4 5 6 7 8 9 10 11 12 13 14
256 258 259 260 261 262 263 264 265 266 267 268 269 270
512 514 515 516 517 518 519 520 521 522 523 524 526
768 769 770 771 772 773 774 775 776 777 778 779 781 782
1025 1026 1027 1029 1032 1034 1035 1036 1038
          >;
    };

      kscan0: kscan {
        compatible = "zmk,kscan-gpio-matrix";
        wakeup-source;

        diode-direction = "col2row";
        row-gpios
            = <&gpio0 29 (GPIO_ACTIVE_HIGH | GPIO_PULL_DOWN)>
            , <&gpio0 4 (GPIO_ACTIVE_HIGH | GPIO_PULL_DOWN)>
            , <&gpio0 31 (GPIO_ACTIVE_HIGH | GPIO_PULL_DOWN)>
            , <&gpio0 30 (GPIO_ACTIVE_HIGH | GPIO_PULL_DOWN)>
            , <&gpio1 10 (GPIO_ACTIVE_HIGH | GPIO_PULL_DOWN)>
            ;
        col-gpios
            = <&gpio0 5  GPIO_ACTIVE_HIGH>
            , <&gpio1 15 GPIO_ACTIVE_HIGH>
            , <&gpio0 3  GPIO_ACTIVE_HIGH>
            , <&gpio0 2  GPIO_ACTIVE_HIGH>
            , <&gpio0 28 GPIO_ACTIVE_HIGH>
            , <&gpio0 22 GPIO_ACTIVE_HIGH>
            , <&gpio1 0  GPIO_ACTIVE_HIGH>
            , <&gpio1 3  GPIO_ACTIVE_HIGH>
            , <&gpio0 10 GPIO_ACTIVE_HIGH>
            , <&gpio1 1  GPIO_ACTIVE_HIGH>
            , <&gpio1 2  GPIO_ACTIVE_HIGH>
            , <&gpio1 4  GPIO_ACTIVE_HIGH>
            , <&gpio1 6  GPIO_ACTIVE_HIGH>
            , <&gpio0 9  GPIO_ACTIVE_HIGH>
            , <&gpio1 11  GPIO_ACTIVE_HIGH>
            ;
    };
    gpio_wake_key: gpio_key_wakeup_trigger {
        compatible = "zmk,gpio-key-wakeup-trigger";
        trigger = <&kscan0>;
        wakeup-source;
        extra-gpios
            = <&gpio0 5  GPIO_ACTIVE_HIGH>
            , <&gpio1 15 GPIO_ACTIVE_HIGH>
            , <&gpio0 3  GPIO_ACTIVE_HIGH>
            , <&gpio0 2  GPIO_ACTIVE_HIGH>
            , <&gpio0 28 GPIO_ACTIVE_HIGH>
            , <&gpio0 22 GPIO_ACTIVE_HIGH>
            , <&gpio1 0  GPIO_ACTIVE_HIGH>
            , <&gpio1 3  GPIO_ACTIVE_HIGH>
            , <&gpio0 10 GPIO_ACTIVE_HIGH>
            , <&gpio1 1  GPIO_ACTIVE_HIGH>
            , <&gpio1 2  GPIO_ACTIVE_HIGH>
            , <&gpio1 4  GPIO_ACTIVE_HIGH>
            , <&gpio1 6  GPIO_ACTIVE_HIGH>
            , <&gpio0 9  GPIO_ACTIVE_HIGH>
            , <&gpio1 11  GPIO_ACTIVE_HIGH>
            ;
    };
};

soft_off_sources: soft_off_wakeup_sources {
    compatible = "zmk,soft-off-wakeup-sources";
    wakeup-sources = <&gpio_wake_key>;
};
};

&adc {
    status = "okay";
};

&gpiote {
    status = "okay";
};

&gpio0 {
    status = "okay";
};

&gpio1 {
    status = "okay";
};

zephyr_udc0: &usbd {
    status = "okay";
};

&flash0 {
    partitions {
        compatible = "fixed-partitions";
        #address-cells = <1>;
        #size-cells = <1>;

        sd_partition: partition@0 {
            label = "sd";
            reg = <0x00000000 0x00001000>;
        };

        code_partition: partition@1000 {
            label = "code";
            reg = <0x00001000 0x000E8000>;
        };

        storage_partition: partition@E9000 {
            label = "storage";
            reg = <0x000E9000 0x00017000>;
        };

        boot_partition: partition@100000 {
            label = "boot";
            reg = <0x00100000 0x00001000>;
        };
    };
};

&obscura60_layout {
    transform = <&default_transform>;
};
