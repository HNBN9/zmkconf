## boards/arm/obscura60/Kconfig.board
```kconfig
# SPDX-License-Identifier: MIT
config BOARD_OBSCURA60
    bool "Obscura60 Keyboard"
    depends on SOC_SERIES_NRF52X
    select SOC_NRF52840
```

## boards/arm/obscura60/Kconfig.defconfig
```kconfig
# SPDX-License-Identifier: MIT

if BOARD_OBSCURA60

config ZMK_KEYBOARD_NAME
    default "Obscura60"

if USB_DEVICE_STACK

config USB_NRFX
    default y

endif # USB_DEVICE_STACK

config BT_CTLR
    default BT

endif # BOARD_OBSCURA60
```

## config/west.yml
```yaml
manifest:

  remotes:
    - name: zmkfirmware
      url-base: https://github.com/zmkfirmware
    - name: hnbn
      url-base: https://github.com/HNBN9

  projects:
    - name: zmk
      remote: hnbn
      revision : with-bootkey
      import: app/west.yml

    - name: zmkconf
      remote: hnbn
      revision: master 

  self:
    path: config
```
